// SPDX-License-Identifier: (GPL-2.0-only OR BSD-2-Clause)
/dts-v1/;

/* Firmware reserves the first 2 MiB of DRAM. */
/memreserve/ 0x80000000 0x200000;

#include "an7581-znxt-zn515xg-d-common.dtsi"

/ {
	model = "ZNXT ZN515XG-D";
	compatible = "znxt,zn515xg-d", "airoha,an7581", "airoha,en7581";
};
