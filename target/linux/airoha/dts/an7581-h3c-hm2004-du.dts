// SPDX-License-Identifier: (GPL-2.0-only OR BSD-2-Clause)
/dts-v1/;

/memreserve/ 0x80000000 0x200000;

#include "an7581-h3c-hm2004-du-common.dtsi"

/ {
	model = "H3C HM2004-DU";
	compatible = "h3c,hm2004-du", "airoha,an7581", "airoha,en7581";
};
